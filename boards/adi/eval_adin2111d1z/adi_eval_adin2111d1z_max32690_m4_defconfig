## boards/adi/eval_adin2111d1z/adi_eval_adin2111d1z_max32690_m4_defconfig
```kconfig
# Copyright (c) 2023-2024 Analog Devices, Inc.
# SPDX-License-Identifier: Apache-2.0

# Enable GPIO
CONFIG_GPIO=y

# Console
CONFIG_CONSOLE=y
CONFIG_UART_CONSOLE=y

# Enable UART
CONFIG_SERIAL=y
CONFIG_UART_INTERRUPT_DRIVEN=y

# Enable Clocks
CONFIG_CLOCK_CONTROL=y


CONFIG_NETWORKING=y
CONFIG_TEST_RANDOM_GENERATOR=n
CONFIG_INIT_STACKS=y

# Enable ADIN2111 10BASE-T1L MAC/PHY


CONFIG_ETH_DRIVER=y
CONFIG_ETH_ADIN2111=y
CONFIG_ETH_ADIN2111_SPI_CFG0=n
CONFIG_NET_L2_ETHERNET=y

CONFIG_NET_IPV4=y

CONFIG_NET_IF_MAX_IPV4_COUNT=2
CONFIG_NET_CONFIG_NEED_IPV4=y

CONFIG_NET_CONFIG_AUTO_INIT=y

CONFIG_MDIO=y
CONFIG_SPI=y
CONFIG_MDIO_INIT_PRIORITY=81
CONFIG_PHY_INIT_PRIORITY=82


CONFIG_ETHERNET_LOG_LEVEL_DBG=y
CONFIG_NET_HOSTNAME_ENABLE=y

# SPI config max32
CONFIG_SPI_ASYNC=n
CONFIG_SPI_MAX32=y
CONFIG_SPI_MAX32_INTERRUPT=y
#CONFIG_SPI_MAX32_DMA=y
```
